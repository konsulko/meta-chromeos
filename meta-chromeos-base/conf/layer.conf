## meta-chromeos-base/conf/layer.conf
```bitbake
# We have a conf and classes directory, add to BBPATH
BBPATH .= ":${LAYERDIR}"

# We have recipes-* directories, add to BBFILES
BBFILES += "${LAYERDIR}/recipes-*/*/*.bb \
            ${LAYERDIR}/recipes-*/*/*.bbappend"

BBFILE_COLLECTIONS += "chromeos-base"
BBFILE_PATTERN_chromeos-base= "^${LAYERDIR}/"
BBFILE_PRIORITY_chromeos-base = "5"
LAYERVERSION_chromeos-base = "4"
LAYERSERIES_COMPAT_chromeos-base = "kirkstone"

IMAGE_CLASSES += "extrausers"

# system wide users
# chronos:x:1000:1000:system_user:/home/chronos/user:/bin/bash
# chronos-access:!:1001:1001:non-chronos user with access to chronos data:/dev/null:/bin/false
EXTRA_USERS_PARAMS = "\
    groupadd --gid 1000 --system chronos ; \
    groupadd --gid 1001 --system chronos-access ; \
    useradd --uid 1000 --gid 1000 --comment 'system_user' --home-dir /home/chronos/user --system --shell /bin/bash chronos ; \
    useradd --uid 1001 --gid 1001 --comment 'non-chronos user with access to chronos data' --home-dir /dev/null --system --shell /bin/false chronos-access \
"
```

## meta-chromeos-bsp/conf/layer.conf
```bitbake
# We have a conf and classes directory, add to BBPATH
BBPATH .= ":${LAYERDIR}"

# We have recipes-* directories, add to BBFILES
BBFILES += "${LAYERDIR}/recipes-*/*/*.bb \
            ${LAYERDIR}/recipes-*/*/*.bbappend"

BBFILE_COLLECTIONS += "chromeos-bsp"
BBFILE_PATTERN_chromeos-bsp = "^${LAYERDIR}/"
BBFILE_PRIORITY_chromeos-bsp = "5"
LAYERVERSION_chromeos-bsp = "4"
LAYERSERIES_COMPAT_chromeos-bsp = "kirkstone"
```

## meta-chromeos-bsp/conf/machine/volteer.conf
```bitbake
#@TYPE: Machine
#@NAME: Volteer
#@DESCRIPTION: Machine configuration for the "volteer" (e.g. Acer Chromebook 515) x86_64 (64-bit; Tiger Lake UP3)."

DEFAULTTUNE ?= "corei7-64"
require conf/machine/include/x86/tune-core2.inc
require conf/machine/include/genericx86-common.inc

SERIAL_CONSOLES_CHECK = "ttyS0"
#For runqemu
QB_SYSTEM_NAME = "qemu-system-x86_64"
```

## meta-chromeos-distro/conf/bblayers.conf.sample
```bitbake
# CHROMEOSBBLAYERS_CONF_VERSION is increased each time build/conf/bblayers.conf
# changes incompatibly
CHROMEOS_BBLAYERS_CONF_VERSION = "2"

BBPATH = "${TOPDIR}"
BBFILES ?= ""

# Use the https://github.com/konsulko/chromeos-yocto-manifest
# repository to ensure you clone the correct layers and revisions
BBLAYERS ?= " \
  ##OEROOT##/meta \
  ##OEROOT##/meta-yocto-bsp \
  ##OEROOT##/../meta-arm/meta-arm-bsp \
  ##OEROOT##/../meta-arm/meta-arm \
  ##OEROOT##/../meta-arm/meta-arm-toolchain \
  ##OEROOT##/../meta-intel \
  ##OEROOT##/../meta-qcom \
  ##OEROOT##/../meta-clang \
  ##OEROOT##/../meta-security \
  ##OEROOT##/../meta-openembedded/meta-oe \
  ##OEROOT##/../meta-openembedded/meta-python \
  ##OEROOT##/../meta-openembedded/meta-perl \
  ##OEROOT##/../meta-openembedded/meta-networking \
  ##OEROOT##/../meta-selinux \
  ##OEROOT##/../meta-browser/meta-chromium \
  ##OEROOT##/../meta-chromeos/meta-chromeos-distro \
  ##OEROOT##/../meta-chromeos/meta-chromeos-bsp \
  ##OEROOT##/../meta-chromeos/meta-chromeos-base \
  "
```

## meta-chromeos-distro/conf/distro/chromeos.conf
```bitbake
DISTRO = "chromeos"
DISTRO_NAME = "ChromeOS (Based on Poky: Yocto Project Reference Distro)"
#DISTRO_VERSION = "4.0+snapshot-${METADATA_REVISION}"
DISTRO_VERSION = "4.0.2"
DISTRO_CODENAME = "kirkstone"
SDK_VENDOR = "-chromeossdk"
SDK_VERSION = "${@d.getVar('DISTRO_VERSION').replace('snapshot-${METADATA_REVISION}', 'snapshot')}"
SDK_VERSION[vardepvalue] = "${SDK_VERSION}"

MAINTAINER = "ChromeOS <chromium-os-dev@chromium.org>"

TARGET_VENDOR = "-chromeos"

LOCALCONF_VERSION = "2"

# Override these in chromeos based distros
CHROMEOS_DEFAULT_DISTRO_FEATURES = "largefile opengl ptest multiarch wayland vulkan"
CHROMEOS_DEFAULT_EXTRA_RDEPENDS = "packagegroup-core-boot"
CHROMEOS_DEFAULT_EXTRA_RRECOMMENDS = "kernel-module-af-packet"

DISTRO_FEATURES ?= "${DISTRO_FEATURES_DEFAULT} ${CHROMEOS_DEFAULT_DISTRO_FEATURES}"

PREFERRED_VERSION_linux-yocto ?= "5.15%"
PREFERRED_VERSION_linux-yocto-rt ?= "5.15%"

SDK_NAME = "${DISTRO}-${TCLIBC}-${SDKMACHINE}-${IMAGE_BASENAME}-${TUNE_PKGARCH}-${MACHINE}"
SDKPATHINSTALL = "/opt/${DISTRO}/${SDK_VERSION}"

DISTRO_EXTRA_RDEPENDS += "${CHROMEOS_DEFAULT_EXTRA_RDEPENDS}"
DISTRO_EXTRA_RRECOMMENDS += "${CHROMEOS_DEFAULT_EXTRA_RRECOMMENDS}"

TCLIBCAPPEND = ""

SANITY_TESTED_DISTROS ?= " \
            poky-3.3 \n \
            poky-3.4 \n \
            ubuntu-16.04 \n \
            ubuntu-18.04 \n \
            ubuntu-20.04 \n \
            ubuntu-21.10 \n \
	    ubuntu-22.04 \n \
            fedora-34 \n \
            fedora-35 \n \
            centos-7 \n \
            centos-8 \n \
            debian-9 \n \
            debian-10 \n \
            debian-11 \n \
            opensuseleap-15.3 \n \
            almalinux-8.5 \n \
            "
# add chromeos sanity bbclass
#INHERIT += "chromeos-sanity"

# QA check settings - a little stricter than the OE-Core defaults
# (none currently necessary as we now match OE-Core)
#WARN_TO_ERROR_QA = "X"
#WARN_QA_remove = "${WARN_TO_ERROR_QA}"
#ERROR_QA_append = " ${WARN_TO_ERROR_QA}"

require conf/distro/include/chromeos-default-distrovars.inc
require conf/distro/include/chromeos-world-exclude.inc
require conf/distro/include/no-static-libs.inc
require conf/distro/include/yocto-uninative.inc
require conf/distro/include/security_flags.inc
INHERIT += "uninative"

BB_SIGNATURE_HANDLER ?= "OEEquivHash"
BB_HASHSERVE ??= "auto"

# Set ChromeOS splash image
SPLASH ?= "psplash-chromeos"
IMAGE_FEATURES:append = " splash"
MACHINE_FEATURES:append = " screen"

DISTRO_FEATURES:append = " ipv6 pam security systemd"

# Override the default 3.0.y version in kirkstone
# with the recipe imported/forked from dunfell
PREFERRED_VERSION_openssl = '1.1.1%'

# By default we want to use clang and llvm
# Individual recipes can override these settings when necessary
TOOLCHAIN ?= "clang"
RUNTIME ?= "llvm"
LIBCPLUSPLUS ?= "-stdlib=libc++"
```

## meta-chromeos-distro/conf/distro/include/chromeos-default-distrovars.inc
```bitbake
STAGING_CHROMEOS_PLATFORM_DIR = "${TMPDIR}/work-shared/${MACHINE}/chromiumos-platform"
CHROMEOS_BASE ??= "${COREBASE}/../meta-chromeos"
CHROMEOS_COMMON_LICENSE_DIR ??= "${CHROMEOS_BASE}/meta-chromeos-base/files/common-licenses"
```

## meta-chromeos-distro/conf/layer.conf
```bitbake
# We have a conf and classes directory, add to BBPATH
BBPATH =. "${LAYERDIR}:"

# We have recipes-* directories, add to BBFILES
BBFILES += "${LAYERDIR}/recipes-*/*/*.bb \
            ${LAYERDIR}/recipes-*/*/*.bbappend"

BBFILE_COLLECTIONS += "chromeos-distro"
BBFILE_PATTERN_chromeos-distro = "^${LAYERDIR}/"
BBFILE_PRIORITY_chromeos-distro = "5"

LAYERSERIES_COMPAT_chromeos-distro = "kirkstone"

# This should only be incremented on significant changes that will
# cause compatibility issues with other layers
LAYERVERSION_chromeos-distro = "3"

LAYERDEPENDS_chromeos-distro = "core chromeos-bsp chromeos-base"

REQUIRED_CHROMEOS_BBLAYERS_CONF_VERSION = "2"
```
